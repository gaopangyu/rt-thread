## bsp/stm32/stm32h743-fk743m2/applications/Kconfig
```kconfig
menu "Applications Config"

    config RT_USING_CUSTOM
        bool "Enable RT_USING_CUSTOM (application custom macros)"
        default y
        help
            When enabled, the build generates #define RT_USING_CUSTOM in rtconfig.h.
            Use #ifdef RT_USING_CUSTOM in application source for conditional code.

    config LIB_PATH
        string "Directory for prebuilt library (.so) files"
        default "diskfs/lib/"
        help
            Path to the directory containing prebuilt static libraries.

    source "$(BSP_DIR)/applications/class/Kconfig"

endmenu
```

## bsp/stm32/stm32h743-fk743m2/applications/class/Kconfig
```kconfig
menu "Class Objects"

    comment "Object class sources under applications/class/"

    config APP_USING_CLASS
        bool "Enable class objects (custom/interface/protocol/upload)"
        select RT_USING_CUSTOM
        default y
        help
            Build applications/class/*.c:
            custom_obj, interface_*, protocol_*, upload_*.

endmenu
```

## bsp/stm32/stm32h743-fk743m2/applications/environment/Kconfig
```kconfig
menu "Environment"

    comment "Board environment sources under applications/environment/"

    config APP_USING_ENVIRONMENT
        bool "Enable environment (rtc / auto_mount / usb0_device)"
        select RT_USING_CUSTOM
        default y
        help
            Build applications/environment/*.c:
            rtc, auto_mount, usb0_device.

endmenu
```

## bsp/stm32/stm32h743-fk743m2/applications/host_model/Kconfig
```kconfig
menu "Host Model"

    comment "Host model sources under applications/host_model/"

    config APP_USING_HOST_MODEL
        bool "Enable host model (host / host_std)"
        select RT_USING_CUSTOM
        default y
        help
            Build applications/host_model/*.c:
            host, host_std.

endmenu
```

## bsp/stm32/stm32h743-fk743m2/board/Kconfig
```kconfig
menu "Hardware Drivers Config"

menu "Onboard Peripheral Drivers"

endmenu

menu "On-chip Peripheral Drivers"

    config BSP_SCB_ENABLE_I_CACHE
        bool "Enable ICACHE"
        default y

    config BSP_SCB_ENABLE_D_CACHE
        bool "Enable DCACHE"
        default y

    config BSP_USING_GPIO
        bool "Enable GPIO"
        select RT_USING_PIN
        default y

    config BSP_USING_QSPI
        bool "Enable QSPI"
        default n

    config BSP_QSPI_USING_DMA
        bool "Enable QSPI DMA/MDMA for flash read"
        depends on BSP_USING_QSPI
        default y
        help
            STM32H7 uses MDMA (not DMA1/2) for QUADSPI receive.

    config BSP_USING_QSPI_FLASH
        bool "Enable QSPI_FLASH"
        default n
        depends on BSP_USING_QSPI

    menuconfig BSP_USING_UART
        bool "Enable UART"
        default y
        select RT_USING_SERIAL
        if BSP_USING_UART
            config BSP_STM32_UART_V1_TX_TIMEOUT
                int "UART TX timeout"
                default 6000
                depends on RT_USING_SERIAL_V1

            menuconfig BSP_USING_UART1
                bool "Enable UART1"
                default n
                if BSP_USING_UART1
                    config BSP_UART1_RX_USING_DMA
                        bool "Enable UART1 RX DMA"
                        depends on BSP_USING_UART1 && RT_SERIAL_USING_DMA
                        default n

                    config BSP_UART1_TX_USING_DMA
                        bool "Enable UART1 TX DMA"
                        depends on BSP_USING_UART1 && RT_SERIAL_USING_DMA
                        default n
                        
                    config BSP_UART1_RX_BUFSIZE
                        int "Set UART1 RX buffer size"
                        range 64 65535
                        depends on RT_USING_SERIAL_V2
                        default 256

                    config BSP_UART1_TX_BUFSIZE
                        int "Set UART1 TX buffer size"
                        range 0 65535
                        depends on RT_USING_SERIAL_V2
                        default 0

                    config BSP_UART1_DMA_PING_BUFSIZE
                        int "Set UART1 RX DMA ping-pong buffer size"
                        range 32 65535
                        depends on RT_USING_SERIAL_V2 && BSP_UART1_RX_USING_DMA
                        default 64    
                endif

            menuconfig BSP_USING_UART2
                bool "Enable UART2"
                default n
                if BSP_USING_UART2
                    config BSP_UART2_RX_USING_DMA
                        bool "Enable UART2 RX DMA"
                        depends on BSP_USING_UART2 && RT_SERIAL_USING_DMA
                        default n

                    config BSP_UART2_TX_USING_DMA
                        bool "Enable UART2 TX DMA"
                        depends on BSP_USING_UART2 && RT_SERIAL_USING_DMA
                        default n
                        
                    config BSP_UART2_RX_BUFSIZE
                        int "Set UART2 RX buffer size"
                        range 64 65535
                        depends on RT_USING_SERIAL_V2
                        default 256

                    config BSP_UART2_TX_BUFSIZE
                        int "Set UART2 TX buffer size"
                        range 0 65535
                        depends on RT_USING_SERIAL_V2
                        default 0

                    config BSP_UART2_DMA_PING_BUFSIZE
                        int "Set UART2 RX DMA ping-pong buffer size"
                        range 32 65535
                        depends on RT_USING_SERIAL_V2 && BSP_UART2_RX_USING_DMA
                        default 64    
                endif

            menuconfig BSP_USING_UART3
                bool "Enable UART3"
                default n
                if BSP_USING_UART3
                    config BSP_UART3_RX_USING_DMA
                        bool "Enable UART3 RX DMA"
                        depends on BSP_USING_UART3 && RT_SERIAL_USING_DMA
                        default n

                    config BSP_UART3_TX_USING_DMA
                        bool "Enable UART3 TX DMA"
                        depends on BSP_USING_UART3 && RT_SERIAL_USING_DMA
                        default n
                        
                    config BSP_UART3_RX_BUFSIZE
                        int "Set UART3 RX buffer size"
                        range 64 65535
                        depends on RT_USING_SERIAL_V2
                        default 256

                    config BSP_UART3_TX_BUFSIZE
                        int "Set UART3 TX buffer size"
                        range 0 65535
                        depends on RT_USING_SERIAL_V2
                        default 0

                    config BSP_UART3_DMA_PING_BUFSIZE
                        int "Set UART3 RX DMA ping-pong buffer size"
                        range 32 65535
                        depends on RT_USING_SERIAL_V2 && BSP_UART3_RX_USING_DMA
                        default 64    
                endif

            menuconfig BSP_USING_UART4
                bool "Enable UART4"
                default n
                if BSP_USING_UART4
                    config BSP_UART4_RX_USING_DMA
                        bool "Enable UART4 RX DMA"
                        depends on BSP_USING_UART4 && RT_SERIAL_USING_DMA
                        default n

                    config BSP_UART4_TX_USING_DMA
                        bool "Enable UART4 TX DMA"
                        depends on BSP_USING_UART4 && RT_SERIAL_USING_DMA
                        default n
                        
                    config BSP_UART4_RX_BUFSIZE
                        int "Set UART4 RX buffer size"
                        range 64 65535
                        depends on RT_USING_SERIAL_V2
                        default 256

                    config BSP_UART4_TX_BUFSIZE
                        int "Set UART4 TX buffer size"
                        range 0 65535
                        depends on RT_USING_SERIAL_V2
                        default 0

                    config BSP_UART4_DMA_PING_BUFSIZE
                        int "Set UART4 RX DMA ping-pong buffer size"
                        range 32 65535
                        depends on RT_USING_SERIAL_V2 && BSP_UART4_RX_USING_DMA
                        default 64    
                endif

            menuconfig BSP_USING_UART5
                bool "Enable UART5"
                default n
                if BSP_USING_UART5
                    config BSP_UART5_RX_USING_DMA
                        bool "Enable UART5 RX DMA"
                        depends on BSP_USING_UART5 && RT_SERIAL_USING_DMA
                        default n

                    config BSP_UART5_TX_USING_DMA
                        bool "Enable UART5 TX DMA"
                        depends on BSP_USING_UART5 && RT_SERIAL_USING_DMA
                        default n
                        
                    config BSP_UART5_RX_BUFSIZE
                        int "Set UART5 RX buffer size"
                        range 64 65535
                        depends on RT_USING_SERIAL_V2
                        default 256

                    config BSP_UART5_TX_BUFSIZE
                        int "Set UART5 TX buffer size"
                        range 0 65535
                        depends on RT_USING_SERIAL_V2
                        default 0

                    config BSP_UART5_DMA_PING_BUFSIZE
                        int "Set UART5 RX DMA ping-pong buffer size"
                        range 32 65535
                        depends on RT_USING_SERIAL_V2 && BSP_UART5_RX_USING_DMA
                        default 64    
                endif

            menuconfig BSP_USING_UART6
                bool "Enable UART6"
                default n
                if BSP_USING_UART6
                    config BSP_UART6_RX_USING_DMA
                        bool "Enable UART6 RX DMA"
                        depends on BSP_USING_UART6 && RT_SERIAL_USING_DMA
                        default n

                    config BSP_UART6_TX_USING_DMA
                        bool "Enable UART6 TX DMA"
                        depends on BSP_USING_UART6 && RT_SERIAL_USING_DMA
                        default n
                        
                    config BSP_UART6_RX_BUFSIZE
                        int "Set UART6 RX buffer size"
                        range 64 65535
                        depends on RT_USING_SERIAL_V2
                        default 256

                    config BSP_UART6_TX_BUFSIZE
                        int "Set UART6 TX buffer size"
                        range 0 65535
                        depends on RT_USING_SERIAL_V2
                        default 0

                    config BSP_UART6_DMA_PING_BUFSIZE
                        int "Set UART6 RX DMA ping-pong buffer size"
                        range 32 65535
                        depends on RT_USING_SERIAL_V2 && BSP_UART6_RX_USING_DMA
                        default 64    
                endif

            menuconfig BSP_USING_UART7
                bool "Enable UART7"
                default n
                if BSP_USING_UART7
                    config BSP_UART7_RX_USING_DMA
                        bool "Enable UART7 RX DMA"
                        depends on BSP_USING_UART7 && RT_SERIAL_USING_DMA
                        default n

                    config BSP_UART7_TX_USING_DMA
                        bool "Enable UART7 TX DMA"
                        depends on BSP_USING_UART7 && RT_SERIAL_USING_DMA
                        default n
                        
                    config BSP_UART7_RX_BUFSIZE
                        int "Set UART7 RX buffer size"
                        range 64 65535
                        depends on RT_USING_SERIAL_V2
                        default 256

                    config BSP_UART7_TX_BUFSIZE
                        int "Set UART7 TX buffer size"
                        range 0 65535
                        depends on RT_USING_SERIAL_V2
                        default 0

                    config BSP_UART7_DMA_PING_BUFSIZE
                        int "Set UART7 RX DMA ping-pong buffer size"
                        range 32 65535
                        depends on RT_USING_SERIAL_V2 && BSP_UART7_RX_USING_DMA
                        default 64    
                endif

            menuconfig BSP_USING_UART8
                bool "Enable UART8"
                default n
                if BSP_USING_UART8
                    config BSP_UART8_RX_USING_DMA
                        bool "Enable UART8 RX DMA"
                        depends on BSP_USING_UART8 && RT_SERIAL_USING_DMA
                        default n

                    config BSP_UART8_TX_USING_DMA
                        bool "Enable UART8 TX DMA"
                        depends on BSP_USING_UART8 && RT_SERIAL_USING_DMA
                        default n
                        
                    config BSP_UART8_RX_BUFSIZE
                        int "Set UART8 RX buffer size"
                        range 64 65535
                        depends on RT_USING_SERIAL_V2
                        default 256

                    config BSP_UART8_TX_BUFSIZE
                        int "Set UART8 TX buffer size"
                        range 0 65535
                        depends on RT_USING_SERIAL_V2
                        default 0

                    config BSP_UART8_DMA_PING_BUFSIZE
                        int "Set UART8 RX DMA ping-pong buffer size"
                        range 32 65535
                        depends on RT_USING_SERIAL_V2 && BSP_UART8_RX_USING_DMA
                        default 64    
                endif


        endif

    source "$(BSP_DIR)/../libraries/HAL_Drivers/drivers/Kconfig"

endmenu

menu "Board extended module Drivers"

endmenu

endmenu
```
